/* DO NOT MODIFY:  This source is generated by the scripts in the
 * vi-firmware repository.
 *
 * Generated for v7.x of the OpenXC VI firmware.
 */

#include "diagnostics.h"
#include "can/canread.h"
#include "can/canwrite.h"
#include "signals.h"
#include "obd2.h"
#include "util/log.h"
#include "config.h"
#include "shared_handlers.h"

namespace can = openxc::can;

using openxc::util::log::debug;
using openxc::util::time::FrequencyClock;
using openxc::pipeline::Pipeline;
using openxc::config::getConfiguration;
using openxc::can::read::booleanDecoder;
using openxc::can::read::stateDecoder;
using openxc::can::read::ignoreDecoder;
using openxc::diagnostics::obd2::handleObd2Pid;
using namespace openxc::signals::handlers;

openxc_DynamicField handleWindshieldWiperStates(const CanSignal* signal, const CanSignal* signals, SignalManager* signalManager, SignalManager* signalManagers,
        int signalCount, Pipeline* pipeline, float value, bool* send) {
    switch(int(value)) {
        case 4:
        case 5:
        case 6:
        case 7:
        case 9:
        case 10:
            return openxc::payload::wrapBoolean(true);
        default:
            return openxc::payload::wrapBoolean(false);
    }
}

openxc_DynamicField handleParkingBrakeStates(const CanSignal* signal, const CanSignal* signals, SignalManager* signalManager, SignalManager* signalManagers,
        int signalCount, Pipeline* pipeline, float value, bool* send) {
    switch(int(value)) {
        case 1:
            return openxc::payload::wrapBoolean(true);
        default:
            return openxc::payload::wrapBoolean(false);
    }
}

openxc_DynamicField handleBrakePedalStates(const CanSignal* signal, const CanSignal* signals, SignalManager* signalManager, SignalManager* signalManagers,
        int signalCount, Pipeline* pipeline, float value, bool* send) {
        return openxc::payload::wrapBoolean(int(value) == 2);
}

const int MESSAGE_SET_COUNT = 1;
CanMessageSet MESSAGE_SETS[MESSAGE_SET_COUNT] = {
    { 0, "type-3", 2, 15, 28, 0 },
};

const int MAX_CAN_BUS_COUNT = 2;
CanBus CAN_BUSES[][MAX_CAN_BUS_COUNT] = {
    { // message set: type-3
        { speed: 500000,
        address: 1,
        maxMessageFrequency: 0,
        rawWritable: true,
        passthroughCanMessages: false,
        bypassFilters: false,
        loopback: false
        },

        { speed: 500000,
        address: 2,
        maxMessageFrequency: 0,
        rawWritable: false,
        passthroughCanMessages: false,
        bypassFilters: false,
        loopback: false
        },

    },
};

const int MAX_MESSAGE_COUNT = 1;
CanMessageDefinition CAN_MESSAGES[][MAX_MESSAGE_COUNT] = {
    { // message set: type-3
        { bus: &CAN_BUSES[0][0], id: 0x01, format: STANDARD, frequencyClock: {0.000000}, forceSendChanged: true}
    },
};

const int MAX_SIGNAL_STATES = 0;
const int MAX_SIGNALS_WITH_STATES_COUNT = 0;
const CanSignalState SIGNAL_STATES[][MAX_SIGNALS_WITH_STATES_COUNT][MAX_SIGNAL_STATES] = {
    { // message set: type-3
        
    },
};

const int MAX_SIGNAL_COUNT = 1;
const CanSignal SIGNALS[][MAX_SIGNAL_COUNT] __attribute__ ((section(".rodata._ZL7SIGNALS"))) = {
    { // message set: type-3
        {message: &CAN_MESSAGES[0][0], genericName: "steering_wheel_angle", bitPosition: 7, bitSize: 34, factor: 2.000000, offset: 2.000000, minValue: -2.000000, maxValue: 5.000000, frequency: 1.000000, sendSame: true, forceSendChanged: false, states: NULL, stateCount: 0, writable: false, decoder: NULL, encoder: NULL}
    },
};

SignalManager SIGNAL_MANAGERS[][MAX_SIGNAL_COUNT] = {
    { // message set: type-3
        {signal: &SIGNALS[0][0], frequencyClock: {SIGNALS[0][0].frequency}},
    },
};

void openxc::signals::initialize(openxc::diagnostics::DiagnosticsManager* diagnosticsManager) {
    switch(getConfiguration()->messageSetIndex) {
    case 0: // message set: type-3
        break;
    }
}

void openxc::signals::loop() {
    switch(getConfiguration()->messageSetIndex) {
    case 0: // message set: type-3
        break;
    }
}

const int MAX_COMMAND_COUNT = 0;
CanCommand COMMANDS[][MAX_COMMAND_COUNT] = {
};

void openxc::signals::decodeCanMessage(Pipeline* pipeline, CanBus* bus, CanMessage* message) {
    switch(getConfiguration()->messageSetIndex) {
    case 0: // message set: type-3
        switch(bus->address) {
        case 1:
            switch (message->id) {
            case 0x01:
                can::read::translateSignal(&SIGNALS[0][0], message, SIGNALS[0], SIGNAL_MANAGERS[0], getSignalCount(), pipeline);
                break;
            }
            break;
        }
        break;
    }
}


CanCommand* openxc::signals::getCommands() {
    return COMMANDS[getActiveMessageSet()->index];
}

int openxc::signals::getCommandCount() {
    return getActiveMessageSet()->commandCount;
}

const CanMessageDefinition* openxc::signals::getMessages() {
    return CAN_MESSAGES[getActiveMessageSet()->index];
}

int openxc::signals::getMessageCount() {
    return getActiveMessageSet()->messageCount;
}

const CanSignal* openxc::signals::getSignals() {
    return SIGNALS[getActiveMessageSet()->index];
}

SignalManager* openxc::signals::getSignalManagers() {
    return SIGNAL_MANAGERS[getActiveMessageSet()->index];
}

int openxc::signals::getSignalCount() {
    return getActiveMessageSet()->signalCount;
}

CanBus* openxc::signals::getCanBuses() {
    return CAN_BUSES[getActiveMessageSet()->index];
}

int openxc::signals::getCanBusCount() {
    return getActiveMessageSet()->busCount;
}

const CanMessageSet* openxc::signals::getActiveMessageSet() {
    return &MESSAGE_SETS[getConfiguration()->messageSetIndex];
}

const CanMessageSet* openxc::signals::getMessageSets() {
    return MESSAGE_SETS;
}

int openxc::signals::getMessageSetCount() {
    return MESSAGE_SET_COUNT;
}

